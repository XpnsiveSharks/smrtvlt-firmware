## components/nvs_storage/Kconfig
```kconfig
menu "SmartVault Configuration"

    config API_BASE_URL
        string "API Base URL"
        default "http://localhost:3000"
        help
            The base URL of the SmartVault API. Can be overridden at runtime via provisioning portal.

endmenu
```

## sdkconfig.defaults
```kconfig
# UART2 for NFC Reader
CONFIG_UART_ISR_IN_IRAM=y

# WiFi
CONFIG_ESP_WIFI_STATIC_RX_BUFFER_NUM=10
CONFIG_ESP_WIFI_DYNAMIC_RX_BUFFER_NUM=32

# TLS — set to y for dev (skip verify), n for prod (cert bundle)
CONFIG_SKIP_TLS_VERIFY=y

# WebSocket
CONFIG_WS_TRANSPORT_MAX_CONTROL_PAYLOAD_LEN=128

# NVS
CONFIG_NVS_ENCRYPTION=n

# Logging
CONFIG_LOG_DEFAULT_LEVEL_INFO=y

# Partition table
CONFIG_PARTITION_TABLE_CUSTOM=y
CONFIG_PARTITION_TABLE_CUSTOM_FILENAME="partitions.csv"
CONFIG_PARTITION_TABLE_OFFSET=0x8000
CONFIG_ESPTOOLPY_FLASHSIZE_4MB=y
CONFIG_ESPTOOLPY_FLASHSIZE="4MB"
```
